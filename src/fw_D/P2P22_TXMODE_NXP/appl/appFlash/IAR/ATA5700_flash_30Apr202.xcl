/*                      - lnkmSigma.xcl -
 *
 *   XLINK command file for the ICCAVR C-compiler using the --cpu=m88, -ms
 *   options. Segments are defined for an ATmega88 whithout external
 *   memory. It is also possible to "add" external SRAM, EPROM and EEPROM.
 *
 *   Usage: xlink your_file(s) -f lnkmSigma
 *
 *   File version: $Revision: 460605 $
 */

/*=================== CONSTANTS =============================*/
/* Constants used in the ranges down below,
 * Do not change these lines,
 * if it is not stated otherwise
 */

/* Code (ROM) segments: 32 Kbyte, 16Kwords */
-D_..X_INTVEC_SIZE=CC   /* 51 Interrupt vectors * 4 bytes each */
-D_..X_ROM_TEND=FF    /* End of tiny flash memory */
-D_..X_ROM_NEND=7FFF  /* End of near flash memory */
-D_..X_ROM_END=7FFF   /* End of flash memory */

/* ROM Immobilizer ROM layout */
-D_..X_ROM_IMMO_END=1FFF        /* End of immobilizer memory */

/* ROM Library ROM layout */
-D_..X_ROM_LIB_START=2000       /* Start of ROM library memory */
-D_..X_ROM_LIB_END=6BFF         /* End of ROM library memory V1.3 */
// -D_..X_ROM_LIB_END=6FFF      /* End of ROM library memory V1.0 */

/* ROM ATE ROM layout */
-D_..X_ROM_ATE_START=6C00       /* Start of ATE memory V2.0 */

/* Code (FLASH) segments: 32 Kbyte, 16Kwords */
-D_..X_FLASH_START=8000 /* Start of flash memory */
-D_..X_FLASH_END=FFFF   /* End of flash memory */
-D_..X_FLASH_ENTRY_SIZE=4

/* Internal data memory */
-D_..X_SRAM_BASE=200    /* Start of ram memory Primus2P */
-D_..X_SRAM_TEND=200    /* End of tiny ram memory */
-D_..X_SRAM_END=5FF     /* End of ram memory Primus2P */

/* Internal EEPROM */
-D_..X_EEPROM_END=97F   /* End of eeprom memory Primus2P */

-D_..X_SRAM_APPL_BASE=300    /* Start of ram memory */
-D_..X_SRAM_APPL_END=597   /* Start of ram memory */




/* Stack */
-D_..X_STACK_BASE=598    /* Start of STACK memory */


/*==================== END OF CONSTANTS =====================*/

/*
 * Modify the lines below to alter the size of the RSTACK, CSTACK and HEAP
 * segments. These need to be fine tuned to suit your specific application.
 * The '_..X_' prefix is used by C-SPY as an indication that the label should
 * not be displayed in the dissassembly window.
 */
-D_..X_CSTACK_SIZE=30   /* 48 bytes for auto variables and saved registers. */
-D_..X_RSTACK_SIZE=38   /* 56 bytes for return addresses, equivalent to 16 */
                        /* levels of calls, including interrupts. */
-D_..X_HEAP_SIZE=0      /* 0 bytes of heap. */
-D_..X_NEAR_HEAP_SIZE=0     /* 0 bytes of heap. */


/* Define CPU */
-ca90

/*
 * The following segments are located in the internal memory of
 * the ATmegaSigma. Do not change these lines.
 */

/* Code memory */
//-Z(CODE)INTVEC=0-(_..X_INTVEC_SIZE-1)
-Z(CODE)INTVEC=_..X_FLASH_START-(_..X_FLASH_START+_..X_INTVEC_SIZE-1)


/* Fill unused interrupt vector's with RETI */
//-h(CODE)0-(_..X_INTVEC_SIZE-1)


-Z(CODE)TINY_F=(_..X_FLASH_START+_..X_INTVEC_SIZE)-_..X_FLASH_END
-Z(CODE)NEAR_F,SWITCH,INITTAB,DIFUNCT=(_..X_FLASH_START+_..X_FLASH_ENTRY_SIZE+_..X_INTVEC_SIZE)-_..X_FLASH_END
-Z(CODE)NEAR_C=(_..X_FLASH_START+_..X_FLASH_ENTRY_SIZE+_..X_INTVEC_SIZE)-_..X_FLASH_END

-Z(CODE)FLASH_ENTRY=(_..X_FLASH_START+_..X_INTVEC_SIZE)-(_..X_FLASH_START+_..X_FLASH_ENTRY_SIZE+_..X_INTVEC_SIZE)
-Z(CODE)CODE=(_..X_FLASH_START+_..X_FLASH_ENTRY_SIZE)-_..X_FLASH_END
-Z(CODE)TINY_ID,NEAR_ID=(_..X_FLASH_START+_..X_INTVEC_SIZE)-_..X_FLASH_END

-Z(CODE).aoipfunctionenhancedmode=C000
-Z(CODE).aoipfunctioncustomcommand=E000
///////////////////////////////////////////////////////////////////////////////
// SRAM configuration (ROM firmware)
///////////////////////////////////////////////////////////////////////////////
-Z(DATA).eventram=_..X_SRAM_BASE
-Z(DATA).flowctrl
-Z(DATA).tmr1ram
-Z(DATA).tmr2ram
-Z(DATA).tmr3ram
-Z(DATA).tmr4ram
-Z(DATA).tmr5ram
-Z(DATA).debug
-Z(DATA).sramAesComponentDataSection
-Z(DATA).spiConfig
-Z(DATA).ata5831
-Z(DATA).rftx
-Z(DATA).lfRssi
-Z(DATA).calib
-Z(DATA).lfRx
-Z(DATA).lfRssiTest

-Z(DATA)__BSS__

//--disable_overlap_check=.sram_FlashApp_LfRssi_BMW,.sram_FlashApp_LfRssi_HFM,.sram_FlashApp_Timer3,.sram_FlashApp_Timer4,.sram_FlashApp_TpRxTx,.sram_FlashApp_ExtIf,.sram_FlashModule_Twi,.sram_FlashModule_Rfrcc
--disable_overlap_check=.sram_FlashApp_LfRssi_BMW,.sram_FlashApp_TpRxTx,.sram_FlashApp_ExtIf,.sram_FlashModule_Twi,.sram_FlashModule_Rfrcc


///////////////////////////////////////////////////////////////////////////////
// SRAM sections used in FLASH Application project
///////////////////////////////////////////////////////////////////////////////
-Z(DATA).sram_FlashApp_Ata5700CommandSet=_..X_SRAM_APPL_BASE
-Z(DATA).sram_FlashApp_TempArray
-Z(DATA).sram_FlashApp_EventHandling
-Z(DATA).sram_FlashApp_Sleep
-Z(DATA).sram_FlashApp_LfRx
-Z(DATA).sram_FlashApp_LfRssi
-Z@(DATA).sram_FlashApp_LfRssi_BMW
-Z@(DATA).sram_FlashApp_ExtIf
-Z@(DATA).sram_FlashApp_TpRxTx
-Z@(DATA).sram_FlashApp_MsgRXbuffer
-Z@(DATA).sram_FlashApp_MsgTXbuffer
//-Z@(DATA).sram_SPI_RXbuffer


//-Z@(DATA).sram_FlashApp_Timer3
//-Z@(DATA).sram_FlashApp_Timer4

///////////////////////////////////////////////////////////////////////////////
// SRAM sections used in FLASH Application project (Module deliverables)
///////////////////////////////////////////////////////////////////////////////
//-Z@(DATA).sram_FlashModule_Twi=429-433
//-Z@(DATA).sram_FlashModule_Rfrcc=434-443
-Z@(DATA).sram_FlashModule_Twi
-Z@(DATA).sram_FlashModule_Rfrcc

///////////////////////////////////////////////////////////////////////////////
// EEPROM configuration
///////////////////////////////////////////////////////////////////////////////

//-----------------------------------------------------------------------------
// EEPROM sections used in FLASH project
//-----------------------------------------------------------------------------
-Z(XDATA).eep_sCustomerEEPromSectionUSRID=08b0
-Z(XDATA).eep_sCustomerEEPromSectionParameterData=0580
//-Z(XDATA).eep_sCustomerEEPromSectionAESkey=0700
//-Z(XDATA).eep_sCustomerEEPromSectionAESkey=0780
//-Z(XDATA).eep_sCustomerEEPromSectionUSRID
//-Z(XDATA).eep_sCustomerEEPromSectionFOBindx
-Z(XDATA).eep_FlashApp_EventHandling=0410
// -Z(XDATA).eep_FlashApp_Aes
// -Z(XDATA).eep_FlashApp_Chflt
-Z(XDATA).eep_FlashApp_Clk
-Z(XDATA).eep_FlashApp_Cpu
// -Z(XDATA).eep_FlashApp_Crc
-Z(XDATA).eep_FlashApp_Debounce
-Z(XDATA).eep_FlashApp_Debug
// -Z(XDATA).eep_FlashApp_Demod
// -Z(XDATA).eep_FlashApp_Dfifo
// -Z(XDATA).eep_FlashApp_Eeprom
// -Z(XDATA).eep_FlashApp_Fe
// -Z(XDATA).eep_FlashApp_Frsync
// -Z(XDATA).eep_FlashApp_Gpioregs
// -Z(XDATA).eep_FlashApp_I2c
-Z(XDATA).eep_FlashApp_Int
// -Z(XDATA).eep_FlashApp_Led
// -Z(XDATA).eep_FlashApp_Lf3d
// -Z(XDATA).eep_FlashApp_LfProtocolHandler
// -Z(XDATA).eep_FlashApp_LfRssi
// -Z(XDATA).eep_FlashApp_Mem
-Z(XDATA).eep_FlashApp_PortB
-Z(XDATA).eep_FlashApp_PortC
-Z(XDATA).eep_FlashApp_PortD
-Z(XDATA).eep_FlashApp_Rfrcc
// -Z(XDATA).eep_FlashApp_RxBuf
// -Z(XDATA).eep_FlashApp_RxDsp
// -Z(XDATA).eep_FlashApp_Sfifo
-Z(XDATA).eep_FlashApp_Spi
// -Z(XDATA).eep_FlashApp_Ssm
-Z(XDATA).eep_FlashApp_Sup
// -Z(XDATA).eep_FlashApp_Symch
// -Z(XDATA).eep_FlashApp_Temper
-Z(XDATA).eep_FlashApp_Timer0Wdt
// -Z(XDATA).eep_FlashApp_Timer1
// -Z(XDATA).eep_FlashApp_Timer2
// -Z(XDATA).eep_FlashApp_Timer3
// -Z(XDATA).eep_FlashApp_Timer4
// -Z(XDATA).eep_FlashApp_Timer5
// -Z(XDATA).eep_FlashApp_Tmo
// -Z(XDATA).eep_FlashApp_TplfCal
// -Z(XDATA).eep_FlashApp_Transponder
// -Z(XDATA).eep_FlashApp_TxDsp
// -Z(XDATA).eep_FlashApp_Txm
-Z(XDATA).eep_FlashApp_LfRssiEndOfLineCalibrationSettings
-Z(XDATA).eep_FlashApp_LfRssiSrcCalibrationSetting
-Z(XDATA).eep_wEepRfrccAddress
-Z(XDATA).eep_sCustomerEEPromSectionRKEPEPS=0060
//-Z(XDATA).eepSecKeyAddrA
//-Z(XDATA).eepSecKeyAddrB

-Z(CODE).versions=0FFF0
-Z(CODE)CHECKSUM=(_..X_FLASH_END-1)


/* Internal data memory */
-Z(DATA)TINY_I,TINY_Z,TINY_N=_..X_SRAM_BASE-_..X_SRAM_TEND
-Z(DATA)NEAR_I,NEAR_Z,NEAR_N=_..X_SRAM_APPL_BASE-_..X_SRAM_APPL_END

/*
 * If external SRAM is available it is possible to place the stacks there.
 * However, the external memory is slower than the internal so moving the
 * stacks to the external memory will degrade the system performance.
 */
-Z(DATA)RSTACK+_..X_RSTACK_SIZE=_..X_STACK_BASE-_..X_SRAM_END
-Z(DATA)CSTACK+_..X_CSTACK_SIZE=_..X_STACK_BASE-_..X_SRAM_END

/*
 * If external SRAM is available it might be a good idea to move the
 * heap segment there, i.e. remove the _..X_SRAM_BASE-_..X_SRAM_END range.
 */
-Z(DATA)HEAP+_..X_HEAP_SIZE=_..X_SRAM_BASE-_..X_SRAM_END
-Z(DATA)IOSTREAM_N#_..X_SRAM_BASE-_..X_SRAM_END
-Z(DATA)NEAR_HEAP+_..X_NEAR_HEAP_SIZE=_..X_SRAM_BASE-_..X_SRAM_END

/* Internal eeprom memory */
-Z(XDATA)EEPROM_I,EEPROM_N=0-_..X_EEPROM_END

/* Select reduced "printf" support to reduce library size.
   See configuration section in manual concerning printf/sprintf. */

/*Dlib*/
-e_PrintfSmall=_Printf

/*Clib*/
-e_small_write=_formatted_write

/*Dlib and Clib*/
-e_small_write_P=_formatted_write_P

/* Disable floating-point support in "scanf" to reduce library size.
   See configuration section in manual concerning scanf/sscanf */

/*Dlib*/
-e_ScanfSmall=_Scanf

/*Clib*/
-e_medium_read=_formatted_read

/*Dlib and Clib*/
-e_medium_read_P=_formatted_read_P

/* Suppress one warning which is not relevant for this processor */
-w29

/* Code will now reside in file aout.a90 or aout.d90, unless -o is specified */
/* .d90 is the default if debug system is linked (option -r) */
/* .a90 is the default without debugging. Default format is -Fmotorola */
-DromVersion=(_..X_ROM_LIB_END-2)
-DromPatchVersion=(_..X_ROM_LIB_END-3)


-Dg_bAoipTxBuffer=231
-Dg_bAoipRxBuffer=256

/*LNKextStart*/
-DATA_aesInit_C=2074
-DATA_aesSetConfig_C=20B8
-DATA_aesTriggerKeyDma_C=20DE
-DATA_aesKeyLoad_C=2100
-DATA_aesEncryptData_C=2210
-DATA_aesDecryptData_C=2280
-DATA_aesLoadData_C=2320
-DATA_aesApplyPaddingScheme_C=2350
-DATA_aesComplete_ISR_C=23BE
-DATA_5831GetRssiValue_C=2444
-DATA_5831StartRssiMeasurement_C=24F4
-DATA_5831InitSramService_C=2588
-DATA_5831ReadTemperatureValue_C=2626
-DATA_5831OffCommand_C=26C2
-DATA_5831SetVoltageMonitor_C=2724
-DATA_5831TriggerEepromSecureWrite_C=27B6
-DATA_5831SystemReset_C=2840
-DATA_5831CustomerConfigurableCommand_C=28A8
-DATA_5831PatchSpi_C=2932
-DATA_5831CalibrateAndCheck_C=29C4
-DATA_5831SetSystemMode_C=2A62
-DATA_5831WriteTxPreambleFifo_C=2B00
-DATA_5831WriteTxFifo_C=2BA8
-DATA_5831ReadEeprom_C=2C50
-DATA_5831WriteEeprom_C=2D00
-DATA_5831ReadSramRegister_C=2DAA
-DATA_5831WriteSramRegister_C=2E6E
-DATA_5831ReadRxFifo_C=2F28
-DATA_5831ReadFillLevelRxFifo_C=2FD6
-DATA_5831ReadFillLevelTxFifo_C=306C
-DATA_5831ReadFillLevelRssiFifo_C=3100
-DATA_5831GetEventBytes_C=3192
-DATA_5831ReadRssiFifo_C=3210
-DATA_5831GetRomVersion_C=32BE
-DATA_5831GetFlashVersion_C=3352
-DATA_5831Init_C=33FA
-DATA_5831Close_C=3446
-DATA_5831Start_C=3462
-DATA_5831StartSckNssTimer_ASM=350E
-DATA_5831CommandReady_ASM=354C
-DATA_5831CommandTimer1Isr_ASM=3572
-DATA_5831ReadCommandFillTxFifo_ASM=3610
-DATA_5831WriteCommandFillTxFifo_ASM=363C
-DATA_5831CommandSpiFifoIsr_ASM=367C
-DATA_5831ReadCommandReadRxFifo_ASM=373A
-DATA_5831ReadCommandReadDummyRxFifo_ASM=3774
-DATA_5831WriteCommandReadRxFifo_ASM=37AC
-DATA_calibInit_C=37D0
-DATA_calibClose_C=3880
-DATA_calibStartCalibration_C=389A
-DATA_calibStartSrcCalibration_C=38F4
-DATA_calibStartFrcCalibration_C=3A16
-DATA_eepFuseRead_C=3B4A
-DATA_eepFuseWrite_C=3B88
-DATA_eepEEPaccessRightsChange_C=3BD6
-DATA_eepFusesFix_C=3CEE
-DATA_eepReadBytes_C=3D0A
-DATA_eepWriteBytes_C=3D74
-DATA_globalsSetClk_C=3DEC
-DATA_globalsWdtDisable_C=3E02
-DATA_globalsWdtEnable_C=3E1C
-DATA_globalsSleep_C=3E34
-DATA_globalsClkSwitchFrc_C=3E4C
-DATA_globalsClkSwitchFrcWithDelay_C=3EA8
-DATA_globalsClkSwitchMrc_C=3EBE
-DATA_globalsClkSwitchSrc_C=3EE6
-DATA_globalsClkSwitchExt_C=3F14
-DATA_globalsClkSwitchXTO_C=3F60
-DATA_globalsDeActivateXTO_C=3F9A
-DATA_globalsActivateXTO_C=3FB4
-DATA_globalsInitSramSpace_C=4008
-DATA_globalsCopySramSpace_C=4018
-DATA_globalsSetVoltageMonitor_C=402E
-DATA_globalsInitDebug_C=4094
-DATA_globalsMulS8U8_ASM=40A2
-DATA_globalsWaitNus_ASM=40B2
-DATA_globalsMulU16U16_ASM=40BC
-DATA_initCheckWakeupSource_C=40EC
-DATA_lfRssiInit_C=40FE
-DATA_lfRssiOpen_C=4126
-DATA_lfRssiClose_C=418A
-DATA_lfRssiSetEepromConfig_C=41D2
-DATA_lfRssiMeasStart_C=4288
-DATA_lfRssiMeasStop_C=4390
-DATA_lfRssiGetAverageResult_C=43D2
-DATA_lfRssiGetSamplesResult_C=446A
-DATA_lfRssiCalcChanCalibVal_C=4516
-DATA_lfRssiCalcChanCorr_C=45B0
-DATA_lfRssiCalc3dVec_C=46E6
-DATA_lfRssiCalcLog2Lin_C=47CC
-DATA_lfRssiCalcBappl_C=489E
-DATA_lfRssiNormalize12q4_C=48D0
-DATA_lfRssiMeasReady_ISR_C=495A
-DATA_lfRxInit_C=49E8
-DATA_rfTxInit_C=4A8E
-DATA_rfTxClose_C=4B12
-DATA_rfTxFillDFifo_C=4B40
-DATA_rfTxFillSFifo_C=4B72
-DATA_rfTxStartTx_C=4BA4
-DATA_rfTxStop_C=4C50
-DATA_rfTxProcessing_C=4C6A
-DATA_rfTxInitTxSSM_C=4C86
-DATA_rfTxWait4AVCC_C=4CF4
-DATA_rfTxInitFrontEnd_C=4D2A
-DATA_rfTxWait4XTO_C=4DFE
-DATA_rfTxStartTxBufSSM_C=4E40
-DATA_rfTxStartTxTransSSM_C=4E44
-DATA_rfTxStartSSM_C=4E48
-DATA_rfTxWait4SSMrdy_C=4EB8
-DATA_rfTxTransparentMode_C=4F56
-DATA_rfTxWait4FillLevel_C=4F58
-DATA_rfTxStartTxModulator_C=4F9C
-DATA_rfTxWait4TransmissionComplete_C=5000
-DATA_rfTxShutdown_C=5052
-DATA_rfTxInitCurrentService_C=50D4
-DATA_rfTxSFifoFillLevelReached_ISR_C=54B0
-DATA_rfTxSFifoError_ISR_C=54D6
-DATA_rfTxDFifoFillLevelReached_ISR_C=5516
-DATA_rfTxDFifoError_ISR_C=553C
-DATA_rfTxSsmRdy_ISR_C=556C
-DATA_rfTxModulatorTelegramFinish_ISR_C=5594
-DATA_rfTxStartSsmWatchdog_C=560A
-DATA_rfTxStopSsmWatchdog_C=5622
-DATA_rfTxStartAnt_C=5626
-DATA_rfTxStopAnt_C=566A
-DATA_rfTxGetAntennaTuningResult_C=5686
-DATA_rfTxStartAntSSM_C=568C
-DATA_rfTxWait4AntSSMrdy_C=5692
-DATA_rfTxStartVco_C=5720
-DATA_rfTxStopVco_C=5762
-DATA_rfTxGetVcoTuningResult_C=577E
-DATA_rfTxInitVcoSSM_C=5784
-DATA_rfTxStartVcoSSM_C=57A8
-DATA_rfTxWait4VcoSSMrdy_C=57AE
-DATA_spiOpen_C=583C
-DATA_spiClose_C=5870
-DATA_spiDataExchange_C=588A
-DATA_spiTransfer_C=5896
-DATA_spiSelect_C=58E0
-DATA_spiDeselect_C=58E6
-DATA_spiRxBufferHandler_ISR_ASM=58EA
-DATA_spiRxBufferDisableInt_ASM=58FC
-DATA_spiRxBufferEnd_ASM=5906
-DATA_spiTxBufferHandler_ISR_ASM=5910
-DATA_spiTxBufferDisableInt_ASM=5922
-DATA_spiTxBufferEnd_ASM=592C
-DATA_timer1Init_C=5936
-DATA_timer1Open_C=594E
-DATA_timer1Close_C=59A6
-DATA_timer2Init_C=59B6
-DATA_timer2Open_C=59CE
-DATA_timer2Close_C=5A26
-DATA_timer3Init_C=5A36
-DATA_timer3Open_C=5A56
-DATA_timer3Close_C=5AC6
-DATA_timer4Init_C=5AD6
-DATA_timer4Open_C=5AF6
-DATA_timer4Close_C=5B66
-DATA_timer5Init_C=5B76
-DATA_timer5Open_C=5B8E
-DATA_timer5Close_C=5BFC
-DATA_tpSwitchAvrPhClock_C=1288




-Dg_sAesComponentData=22A
-Dg_sAta5831=255
-Dg_sCalibConfig=2A1
-Dg_sAtmelEEPromSection=880
-Dg_sCustomerEEPromSection=800
-Dg_sDebug=228
-Dg_sLfRssi=294
-Dg_sLfRx=2AD
-Dg_sRfTx=26A
-Dg_sRfTxCurrentService=271
-Dg_sRfTxFlowCtrl=200
-Dg_pRfTxBufStateMachine=203
-Dg_pRfTxTransStateMachine=205
-Dg_bAntennaTuningResult=292
-Dg_pRfTxAntTuneStateMachine=207
-Dg_bVcoTuningResult=293
-Dg_pRfTxVcoTuneStateMachine=209
-Dg_sSpiConfig=24F
-Dg_sTimer1=20B
-Dg_sTimer2=210
-Dg_sTimer3=215
-Dg_sTimer4=21C
-Dg_sTimer5=223
/*LNKextEnd*/